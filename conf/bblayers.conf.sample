## conf/bblayers.conf.sample
```bitbake
# POKY_BBLAYERS_CONF_VERSION is increased each time build/conf/bblayers.conf
# changes incompatibly
POKY_BBLAYERS_CONF_VERSION = "2"

BBPATH = "${TOPDIR}"
BBFILES ?= ""

BBLAYERS ?= " \
  ##OEROOT##/meta \
  ##OEROOT##/meta-poky \
  ##OEROOT##/meta-yocto-bsp \
  ##OEROOT##/../meta-openembedded/meta-oe \
  ##OEROOT##/../meta-openembedded/meta-filesystems \
  ##OEROOT##/../meta-openembedded/meta-gnome \
  ##OEROOT##/../meta-openembedded/meta-xfce \
  ##OEROOT##/../meta-openembedded/meta-initramfs \
  ##OEROOT##/../meta-openembedded/meta-networking \
  ##OEROOT##/../meta-openembedded/meta-multimedia \
  ##OEROOT##/../meta-openembedded/meta-python \
  ##OEROOT##/../meta-lxde \
  ##OEROOT##/../meta-browser \
  ##OEROOT##/../meta-qt5 \
  ##OEROOT##/../meta-qt5-extra \
  ##OEROOT##/../meta-rust \
  ##OEROOT##/../meta-freescale-distro \
  ##OEROOT##/../meta-toradex-mender \
  ##OEROOT##/../meta-mender/meta-mender-core \
  ##OEROOT##/../meta-mender/meta-mender-demo \
"

include bblayers.${TORADEX_TEMPLATE}.inc
```

## conf/layer.conf
```bitbake
# We have a conf and classes directory, add to BBPATH
BBPATH .= ":${LAYERDIR}"

# We have recipes-* directories, add to BBFILES
BBFILES += "${LAYERDIR}/recipes-*/*/*.bb \
            ${LAYERDIR}/recipes-*/*/*.bbappend"

BBFILE_COLLECTIONS += "toradex-mender"
BBFILE_PATTERN_toradex-mender = "^${LAYERDIR}/"
BBFILE_PRIORITY_toradex-mender = "1000"

LAYERDEPENDS_toradex-mender = "core mender"
LAYERSERIES_COMPAT_toradex-mender = "thud"
```

## conf/machine/include/colibri-imx6ull-mender.inc
```bitbake
MACHINEOVERRIDES =. "use-mainline-bsp:use-head-next:"

SOC_DEFAULT_IMAGE_FSTYPES_colibri-imx6ull = "tezimender"

KERNEL_DEVICETREE_colibri-imx6ull = "imx6ull-colibri-eval-v3.dtb"

PREFERRED_PROVIDER_u-boot-fw-utils = "libubootenv"
PREFERRED_RPROVIDER_u-boot-fw-utils = "libubootenv"
```

## conf/machine/include/qemuarm64-mender.inc
```bitbake
UBOOT_MACHINE = "qemu_arm64_defconfig"
UBOOT_ENTRYPOINT = "0x40080000"

KERNEL_CLASSES = "kernel-mender-fitimage"
KERNEL_IMAGETYPE_qemuarm64 = "fitImage"

IMAGE_BOOT_FILES_qemuarm64 = "boot.scr"
WKS_FILE_DEPENDS_append = " virtual/bootloader u-boot-default-script"

# We are using fitimage for qemuarm64 machine
MACHINE_ESSENTIAL_EXTRA_RDEPENDS_remove = "kernel-devicetree"

QB_MACHINE = "-machine virt"
QB_DRIVE_TYPE = "/dev/vda"
QB_DEFAULT_FSTYPE = "sdimg"
QB_ROOTFS_OPT = "-drive file=@ROOTFS@,if=sd,format=raw"
QB_MEM_qemuarm64 = "-m 1057"
QB_OPT_APPEND_qemuarm64 = "-show-cursor -device VGA,edid=on -device qemu-xhci -device usb-tablet -device usb-kbd -object rng-random,filename=/dev/urandom,id=rng0 -device virtio-rng-pci,rng=rng0 -no-acpi -bios ${DEPLOY_DIR_IMAGE}/u-boot.bin -d unimp -semihosting-config enable,target=native"

PREFERRED_RPROVIDER_network-configuration_qemuarm64 = "networkd-static-conf"
PREFERRED_RPROVIDER_u-boot-default-script_qemuarm64 = "u-boot-mender-boot"
PREFERRED_RPROVIDER_u-boot-default-env = "u-boot-env"
```
